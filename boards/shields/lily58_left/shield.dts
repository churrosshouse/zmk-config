/ {
    compatible = "zmk,keyboard";

    &i2c1 {
        status = "okay";

        ssd1306@3c {
            compatible = "solomon,ssd1306fb";
            reg = <0x3c>;
            width = <128>;
            height = <64>;
            rotation = <0>;
        };
    };
};
